## boards/bk7258/aidk_ai_toy/configs/csi_ap/defconfig
```kconfig
# SPDX-License-Identifier: Apache-2.0
# Raw CSI diagnostic: AP networking only, with no product auto-start.
# CONFIG_DEV_CONSOLE is not set
# CONFIG_SERIAL is not set
CONFIG_ARCH="arm"
CONFIG_ARCH_BOARD_CUSTOM=y
CONFIG_ARCH_BOARD_CUSTOM_DIR="../vendor/beken/boards/bk7258/aidk_ai_toy"
CONFIG_ARCH_BOARD_CUSTOM_DIR_RELPATH=y
CONFIG_ARCH_BOARD_CUSTOM_NAME="aidk_ai_toy"
CONFIG_ARCH_CHIP_ARM_CUSTOM=y
CONFIG_ARCH_CHIP_BK7258=y
CONFIG_ARCH_CHIP_CUSTOM=y
CONFIG_ARCH_CHIP_CUSTOM_DIR="../vendor/beken/chips/bk7258"
CONFIG_ARCH_CHIP_CUSTOM_DIR_RELPATH=y
CONFIG_ARCH_CHIP_CUSTOM_NAME="bk7258"
CONFIG_ARCH_INTERRUPTSTACK=2048
CONFIG_BK7258_BOARD_AIDK_AI_TOY=y
CONFIG_BK7258_AP_CORE=y
CONFIG_BK7258_AP_IPI=y
CONFIG_BK7258_AP_SMP_BOOTSTRAP=y
CONFIG_BK7258_AP_SMP_SCHED_ONLINE=y
CONFIG_BK7258_AP_SUPERVISOR=y
CONFIG_BK7258_PSRAM=y
CONFIG_BK7258_PSRAM_SYSTEM_HEAP=y
CONFIG_BK7258_PSRAM_SYSTEM_HEAP_SIZE=0x80000
CONFIG_BK7258_SDK_SRAM_HEAP=y
CONFIG_BK7258_SDK_SRAM_HEAP_SIZE=0x4000
CONFIG_BK7258_STORAGE_FIXED_BLOCK=y
CONFIG_BK7258_PM_CLOCK=y
CONFIG_BK7258_RPTUN=y
CONFIG_BK7258_RPTUN_LAYOUT=y
CONFIG_BK7258_RPTUN_MBOX=y
CONFIG_BK7258_WIFI_VNET=y
CONFIG_BK7258_WIFI_CSI=y
CONFIG_IDLETHREAD_STACKSIZE=2048
CONFIG_INIT_ENTRYPOINT="bk7258_ap_main"
CONFIG_MM_REGIONS=3
CONFIG_NET=y
CONFIG_NET_ETH_PKTSIZE=1514
CONFIG_NET_UDP=y
CONFIG_NET_UDP_WRITE_BUFFERS=y
CONFIG_NET_SOLINGER=y
CONFIG_IOB_NBUFFERS=64
CONFIG_RAW_BINARY=y
CONFIG_RPTUN_AUTO_RESET_DISABLE=y
CONFIG_RR_INTERVAL=200
CONFIG_SCHED_HPWORK=y
CONFIG_SMP=y
CONFIG_SMP_DEFAULT_CPUSET=0x1
CONFIG_SMP_NCPUS=2
CONFIG_SYSLOG_BUFFER=y
CONFIG_SYSLOG_INTBUFFER=y
CONFIG_SYSLOG_INTBUFSIZE=512
CONFIG_SYSLOG_PREFIX=y
CONFIG_SYSLOG_PREFIX_STRING="ap"
CONFIG_SYSLOG_PRIORITY=y
CONFIG_SYSLOG_PROCESSID=y
CONFIG_SYSLOG_RPMSG=y
CONFIG_SYSLOG_RPMSG_BUFSIZE=1024
CONFIG_SYSLOG_RPMSG_SERVER_NAME="cp"
CONFIG_SYSLOG_RPMSG_WORK_DELAY=20
# CONFIG_SYSLOG_RPMSG_CHARDEV is not set
CONFIG_SYSLOG_TIMESTAMP=y
CONFIG_SYSTEM_TIME64=y
```

## boards/bk7258/aidk_ai_toy/configs/native_nsh/defconfig
```kconfig
# SPDX-License-Identifier: Apache-2.0
# Native CP kernel/console diagnostic; optional product devices are excluded.
CONFIG_ARCH="arm"
CONFIG_ARCH_BOARD_CUSTOM=y
CONFIG_ARCH_BOARD_CUSTOM_DIR="../vendor/beken/boards/bk7258/aidk_ai_toy"
CONFIG_ARCH_BOARD_CUSTOM_DIR_RELPATH=y
CONFIG_ARCH_BOARD_CUSTOM_NAME="aidk_ai_toy"
CONFIG_ARCH_CHIP_ARM_CUSTOM=y
CONFIG_ARCH_CHIP_BK7258=y
CONFIG_ARCH_CHIP_CUSTOM=y
CONFIG_ARCH_CHIP_CUSTOM_DIR="../vendor/beken/chips/bk7258"
CONFIG_ARCH_CHIP_CUSTOM_DIR_RELPATH=y
CONFIG_ARCH_CHIP_CUSTOM_NAME="bk7258"
CONFIG_ARCH_INTERRUPTSTACK=2048
# CONFIG_ARCH_PERF_EVENTS is not set
CONFIG_ARMV8M_SYSTICK=y
CONFIG_BK7258_BOARD_AIDK_AI_TOY=y
CONFIG_BK7258_CONSOLE_UART0=y
CONFIG_BK7258_UART0_BAUD=115200
CONFIG_BK7258_SDK_IRQ_BRIDGE=y
# CONFIG_BK7258_AIDK_WAKE_REPLY_PCM is not set
# CONFIG_BK7258_AP_AUTOSTART is not set
# CONFIG_BK7258_AP_CONTROL is not set
# CONFIG_BK7258_AP_SUPERVISOR is not set
# CONFIG_BK7258_APP_OTA is not set
# CONFIG_BK7258_APP_WIFI is not set
# CONFIG_BK7258_BT_IPC is not set
# CONFIG_BK7258_CLOCK_240M is not set
# CONFIG_BK7258_DVFS is not set
# CONFIG_BK7258_FLASH_MTD is not set
# CONFIG_BK7258_GPIO_LOWERHALF is not set
# CONFIG_BK7258_OTA is not set
# CONFIG_BK7258_PM_CLOCK is not set
# CONFIG_BK7258_PM_COORDINATED_STANDBY is not set
# CONFIG_BK7258_PM_POLICY is not set
# CONFIG_BK7258_PM_SOFT_OFF is not set
# CONFIG_BK7258_PSRAM is not set
# CONFIG_BK7258_PSRAM_SYSTEM_HEAP is not set
# CONFIG_BK7258_RPTUN is not set
# CONFIG_BK7258_RPTUN_LAYOUT is not set
# CONFIG_BK7258_SARADC_SERVER is not set
# CONFIG_BK7258_SDK_IPC_RUNTIME is not set
# CONFIG_BK7258_STORAGE_ONCHIP_PERSISTENT is not set
# CONFIG_BK7258_SWD_DEBUG is not set
# CONFIG_BK7258_TEMP_SERVER is not set
# CONFIG_BK7258_WDT is not set
# CONFIG_BK7258_WIFI_VNET is not set
CONFIG_BOARDCTL_RESET=y
CONFIG_BUILTIN=y
CONFIG_FS_PROCFS=y
CONFIG_IDLETHREAD_STACKSIZE=2048
CONFIG_INIT_ENTRYPOINT="nsh_main"
CONFIG_NSH_ARCHINIT=y
CONFIG_NSH_BUILTIN_APPS=y
CONFIG_NSH_CONSOLE=y
# CONFIG_NSH_DISABLEBG is not set
# CONFIG_NSH_DISABLE_PS is not set
# CONFIG_NSH_DISABLE_SLEEP is not set
CONFIG_NSH_READLINE=y
CONFIG_RAW_BINARY=y
CONFIG_RR_INTERVAL=200
CONFIG_SCHED_LPWORK=y
CONFIG_SIG_DEFAULT=y
CONFIG_SYSTEM_NSH=y
CONFIG_SYSTEM_TIME64=y
CONFIG_TIMER=y
CONFIG_TIMER_ARCH=y
# CONFIG_WATCHDOG_AUTOMONITOR is not set
```

## boards/bk7258/common/Kconfig
```kconfig
#
# NuttX board configuration for the Beken BK7258 logical board.
#

config ARCH_BOARD_BK7258
	bool "Beken BK7258 platform"
	depends on ARCH_BOARD_CUSTOM
	default y
	select BOARD_LATE_INITIALIZE
	---help---
		Board-level bindings for the shared BK7258 chip implementation.  The
		late hook runs the board-owned stage order and passes immutable product
		storage topology into chip mechanisms.  The selected physical-board
		directory supplies its own identity, GPIOs and capabilities.

# Hidden physical capabilities used only by board/application policy.  Chip
# Kconfig exposes SoC mechanisms without depending on board-layer symbols.

config BK7258_BOARD_HAS_USER_GPIO_BINDING
	bool

config BK7258_BOARD_HAS_SDIO_BINDING
	bool

config BK7258_BOARD_HAS_SDIO_4BIT
	bool

config BK7258_BOARD_DEFAULT_SDIO_4BIT
	bool
	depends on BK7258_BOARD_HAS_SDIO_4BIT

config BK7258_BOARD_HAS_UART2_ROUTE
	bool

config BK7258_BOARD_HAS_LVGL_UI_BINDING
	bool

config BK7258_BOARD_DEFERRED_INIT
	bool
	depends on BK7258_AP_CORE
	help
		The selected physical board provides a non-blocking post-READY hook
		which starts low-priority discovery of optional attached devices.
		The hook itself must return promptly: storage/media probing and other
		potentially blocking device work belongs in the task it starts, never
		in the AP readiness path.

# UART2 is a chip controller, but the legal pin group is physical-board
# wiring.  A board must explicitly publish a verified route capability before
# this choice becomes visible.

if BK7258_UART2 && BK7258_BOARD_HAS_UART2_ROUTE

choice
	prompt "Board UART2 pin route"
	default BK7258_UART2_PINS_P30_P31

config BK7258_UART2_PINS_P30_P31
	bool "P31 TX / P30 RX"

config BK7258_UART2_PINS_P40_P41
	bool "P41 TX / P40 RX"
	help
		This alternate chip mux shares P40/P41 with display and I2S2
		functions.  The paired CP/AP build validation checks ownership.

endchoice

endif

# The Beken V2 SDIO data helpers compile the bus width into the selected SDK
# bundle.  Keep the NuttX capability and SDK profile choice explicit and
# constrained by physical-board wiring.

config BK7258_SDIO_4BIT
	bool "Use four-bit SDIO bus"
	default y if BK7258_BOARD_DEFAULT_SDIO_4BIT
	depends on BK7258_BOARD_HAS_SDIO_4BIT
	help
		Enable D1/D2/D3 in addition to CLK/CMD/D0.  The selected physical
		board decides whether those pins are routed safely and whether four-bit
		operation is the default.  This option requires the separately identified
		v3.1.1.9-sdio4 AP SDK bundle because the vendor data helpers reapply
		their compile-time width on every transfer.

# Persistent storage is a system topology, independent of any application or
# physical-board name.  A selected board supplies only the required hardware
# capability and electrical binding.

config BK7258_STORAGE_ONCHIP_PERSISTENT
	bool "Persistent data on BK7258 on-chip Flash"
	default n
	depends on ARCH_BOARD_BK7258 && ARCH_CHIP_BK7258 && !BK7258_AP_CORE
	select BK7258_FLASH_MTD
	select FS_LITTLEFS
	help
		Expose the CSV-selected persistent_data range through MTD and mount
		LittleFS at /data.  Ordinary boot never auto-formats the range.

config BK7258_STORAGE_REMOVABLE_BLOCK
	bool "Persistent data on removable block media"
	default n
	depends on ARCH_BOARD_BK7258 && ARCH_CHIP_BK7258 && BK7258_AP_CORE
	depends on BK7258_BOARD_HAS_SDIO_BINDING
	help
		Use an already provisioned removable block medium.  Partitioning and
		formatting are explicit provisioning operations, never boot actions.

config BK7258_STORAGE_FIXED_BLOCK
	bool "Persistent data on fixed block media"
	default n
	depends on ARCH_BOARD_BK7258 && ARCH_CHIP_BK7258 && BK7258_AP_CORE
	depends on BK7258_BOARD_HAS_SDIO_BINDING
	help
		Use an already provisioned soldered block medium.  Capacity is read
		from the device; no nominal board size becomes a coded end address.

config BK7258_OTA
	bool "Paired MCUboot OTA staging on CP"
	default n
	depends on ARCH_BOARD_BK7258 && ARCH_CHIP_BK7258 && !BK7258_AP_CORE
	depends on BK7258_MCUBOOT_IMAGE
	select CRYPTO
	select BK7258_WDT
	---help---
		Enable the chip-owned CP/AP pair update engine with the board-owned
		layout and serialized storage binding.  The engine writes only the
		physical inactive pair, completes AP before CP, and commits CP sector
		zero last.  It validates the selected layout, exact physical sizes and
		streamed SHA-256 digests supplied by an authenticated source manifest.
		Runtime health confirmation updates both standard MCUboot image_ok
		trailers.  The application owns transport and package download; the
		board owns the optional generation-bound trial policy.

if BK7258_OTA

config BK7258_OTA_AUTO_CONFIRM
	bool "Automatically confirm a healthy pending CP/AP pair"
	default n
	depends on BK7258_AP_SUPERVISOR
	help
		Start a CP-only policy worker when BL2 boots a pending pair.  Confirmation
		requires fresh CP/AP, CPU2 and RPMsg Supervisor health for one continuous
		stable interval.  A generation change or trial deadline triggers
		whole-device reset so BL2 can select the confirmed fallback.  Product
		application voting remains an optional higher-level adapter.

config BK7258_OTA_TRIAL_PRIORITY
	int "OTA trial policy priority"
	default 190
	range 1 199
	depends on BK7258_OTA_AUTO_CONFIRM
	help
		Keep the policy below the AP Supervisor while above ordinary application
		tasks.  Flash confirmation remains serialized by the Flash guard.

config BK7258_OTA_TRIAL_STACKSIZE
	int "OTA trial policy stack size"
	default 3072
	range 2048 8192
	depends on BK7258_OTA_AUTO_CONFIRM

config BK7258_OTA_TRIAL_POLL_MS
	int "OTA trial policy poll interval (milliseconds)"
	default 250
	range 50 2000
	depends on BK7258_OTA_AUTO_CONFIRM

config BK7258_OTA_TRIAL_STABLE_MS
	int "Continuous CP/AP platform health before confirm (milliseconds)"
	default 10000
	range 5000 120000
	depends on BK7258_OTA_AUTO_CONFIRM

config BK7258_OTA_TRIAL_TIMEOUT_MS
	int "Pending trial deadline before revert reset (milliseconds)"
	default 60000
	range 15000 600000
	depends on BK7258_OTA_AUTO_CONFIRM

config BK7258_OTA_TRIAL_HEALTH_MAX_AGE_MS
	int "Maximum accepted Supervisor sample age (milliseconds)"
	default 2000
	range 500 10000
	depends on BK7258_OTA_AUTO_CONFIRM

config BK7258_OTA_TRIAL_CONFIRM_TIMEOUT_MS
	int "Maximum in-progress pair confirmation time (milliseconds)"
	default 10000
	range 6000 30000
	depends on BK7258_OTA_AUTO_CONFIRM
	help
		Independent lease for the Flash-guard wait and two trailer RMWs.  The
		deadline worker uses this while state is CONFIRMING instead of the normal
		policy heartbeat timeout, preventing a false reset during bounded Flash
		contention while still failing closed if confirmation stalls.

endif
```

## boards/bk7258/t5_board/Kconfig
```kconfig
# Shared BK7258 options; this board's defconfigs select T5-Board.
source "../vendor/beken/boards/bk7258/common/Kconfig"

config BK7258_T5_BOARD_LCD
	bool "RGB framebuffer with ILI9488 panel"
	default n
	depends on BK7258_BOARD_T5_BOARD && BK7258_AP_CORE && BK7258_PSRAM
	select BK7258_LCD_RGB
	select LCD_ILI9488_RGB
	help
		Bind the T5-Board V1.0.2 RGB connector and T35P128CQ-02 ILI9488
		panel to the BK7258 RGB framebuffer controller.  The scanout buffer
		is exported as /dev/fb0.

config BK7258_LCD_VALIDATION_PATTERN
	bool "Fill the LCD with a startup validation pattern"
	default n
	depends on BK7258_T5_BOARD_LCD
	help
		Fill /dev/fb0 with red, green, blue and white bars after framebuffer
		registration.  This is a T5-Board display bring-up option.

config BK7258_GT1151
	bool "GT1151 capacitive touch panel"
	default n
	depends on BK7258_AP_CORE
	select I2C
	select I2C_BITBANG
	select INPUT
	select INPUT_GT9XX
	help
		Register the T5-Board LCD sub-board GT1151 through NuttX's standard
		GT9xx driver.  GPIO13/GPIO15 form its board-owned bitbang-I2C bus.

config BK7258_GT1151_VALIDATION
	bool "Continuously report GT1151 validation samples"
	default n
	depends on BK7258_GT1151
	help
		Report samples from the T5-Board GT1151 /dev/input0 device for
		driver-check configurations.
```

## nuttx/drivers/contactless/Kconfig.mfrc522
```kconfig
# SPDX-License-Identifier: Apache-2.0
config CL_MFRC522_FRAME
	bool "MFRC522 with selected-card CRC_A frame exchange"
	select SPI
	select DRIVERS_CONTACTLESS
	help
		NuttX MFRC522 driver plus bounded frame exchange for an upper
		ISO-DEP owner. Select only one MFRC522 implementation.

config CL_MFRC522_FRAME_SPI_FREQ
	int "MFRC522 frame driver SPI frequency"
	depends on CL_MFRC522_FRAME
	default 1000000

config CL_ISODEP
	bool "ISO-DEP reader protocol"
	help
		Transport-independent ISO14443-4 Type A reader session support.
		The caller supplies selected-card CRC_A exchange and RF ownership.

config CL_MFRC522_RF
	bool "MFRC522 with explicit RF ownership"
	select SPI
	select DRIVERS_CONTACTLESS
	help
		Standard NuttX MFRC522 protocol driver with explicit antenna
		control and idle-off registration. No raw-frame or ISO-DEP claim.
		Select only one MFRC522 implementation.

config CL_MFRC522_RF_SPI_FREQ
	int "MFRC522 controlled reader SPI frequency"
	depends on CL_MFRC522_RF
	default 1000000
```

## nuttx/drivers/input/Kconfig.gt9xx
```kconfig
# SPDX-License-Identifier: Apache-2.0
#
# Local build selector for the unchanged upstream GT9xx driver.

config INPUT_GT9XX_STANDARD_IOCTL
	bool "Goodix GT9xx driver (legacy BK7258 selector)"
	default n
	select INPUT_TOUCHSCREEN
	help
		Compile the official Goodix GT9xx input driver through the BK7258
		build integration. This legacy selector does not add ioctls: the
		driver returns single-point touch samples without TSIOC_GETMAXPOINTS.
		Do not enable it with INPUT_GT9XX, which builds the same driver.

if INPUT_GT9XX_STANDARD_IOCTL

config INPUT_GT9XX_STANDARD_IOCTL_NPOLLWAITERS
	int "Number of waiters to poll"
	default 1
	help
		Maximum number of threads that can be waiting on poll().

config INPUT_GT9XX_STANDARD_IOCTL_I2C_FREQUENCY
	int "I2C frequency (Hz)"
	default 400000
	help
		I2C frequency in Hz.

endif # INPUT_GT9XX_STANDARD_IOCTL
```

## nuttx/drivers/lcd/Kconfig.gc9d01
```kconfig
config LCD_GC9D01
	bool "GalaxyCore GC9D01 TFT Controller"
	default n
	select LCD_NOGETRUN
	help
		Enable the transport-independent GC9D01 160x160 RGB565 LCD driver.
		The board or SoC lower half supplies reset, command, pixel-transfer and
		optional backlight callbacks.

if LCD_GC9D01

config LCD_GC9D01_NINTERFACES
	int "Number of GC9D01 devices"
	default 1
	range 1 4
	help
		Specifies the number of independently connected GC9D01 panels.

endif # LCD_GC9D01
```

## nuttx/drivers/lcd/Kconfig.ili9488_rgb
```kconfig
config LCD_ILI9488_RGB
	bool "ILI9488 RGB panel initializer"
	default n
	help
		Enable the transport-independent ILI9488 RGB panel register
		initializer.  A board and SoC transport supply reset and command/data
		write callbacks; this driver does not configure RGB scanout hardware.
```

## nuttx/drivers/sensors/Kconfig.sc7a20
```kconfig
# SPDX-License-Identifier: Apache-2.0

config SENSORS_SC7A20
	bool "SC7A20 accelerometer"
	default n
	depends on SENSORS
	help
		Enable the transport-independent SC7A20 accelerometer driver.  A board
		or SoC binding supplies register read/write callbacks; the driver owns
		device identity, output-rate control, SI-unit conversion and the
		standard NuttX uORB sensor lower half.
```
