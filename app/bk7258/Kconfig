## app/vela_claw/Kconfig
```kconfig
#
# For a description of the syntax of this configuration file,
# see the file kconfig-language.txt in the NuttX tools repository.
#

config BK7258_APP_VELA_CLAW
	bool "Vela-Claw AI agent (openvela/NuttX native)"
	default n
	depends on SYSTEM_NSH
	select BUILTIN
	select NSH_BUILTIN_APPS
	---help---
		Vela-Claw: an on-device "Chat Coding" AI agent for openvela/NuttX
		IoT devices. A faithful, openvela-native rework of Espressif's
		esp-claw. Runs an LLM agent loop (perceive -> decide -> execute)
		with a pluggable transport (mock for offline, libcurl for the real
		cloud LLM) and a capability/Lua tool system. Input channels: serial
		CLI and an optional LVGL screen UI.

if BK7258_APP_VELA_CLAW

config BK7258_APP_VELA_CLAW_PROGNAME
	string "program name"
	default "vela_claw"

config BK7258_APP_VELA_CLAW_PRIORITY
	int "vela_claw priority"
	default 100

config BK7258_APP_VELA_CLAW_STACKSIZE
	int "vela_claw stack size"
	default 8192
	---help---
		The agent worker thread, LVGL (when enabled) and Lua execution
		share this stack budget; 8 KiB is a safe default.

config VELA_CLAW_UI
	bool "Enable screen UI (LVGL)"
	default n
	select GRAPHICS_LVGL
	---help---
		Render the chat UI with LVGL. This only selects the software stack
		(LVGL) needed to build the screen UI; the physical display and touch
		device are board-level decisions and must be enabled by the board
		defconfig (e.g. BK7258_LCD + BK7258_GT1151 for the T5-Board RGB LCD +
		GT1151 touch). The screen UI is an input channel that emits the same
		claw_event (platform "ui") as the serial CLI, and draws agent replies
		via its own response sender. When off, only the serial CLI is
		available.

		NOTE: the openvela UIKit framework (frameworks/graphics/uikit) is not
		selected here. Its library sources use LVGL APIs (LV_GLOBAL_DEFAULT)
		without including lvgl.h, so it does not compile in this tree; vela_claw
		drives LVGL directly via lv_init()/lv_deinit() instead.

config VELA_CLAW_NET
	bool "Enable networking for the real cloud LLM (WiFi STA)"
	default n
	select NET
	select BK7258_WIFI_VNET
	select LIBCURL4NX
	---help---
		Enable CONFIG_NET + BK7258_WIFI_VNET so the curl transport can reach
		the cloud LLM over Wi-Fi. Without this, the app runs with the mock
		transport (offline demo). Requires the CP-side vnet proxy.

endif
```

## board/bk7258/Kconfig
```kconfig
#
# NuttX board configuration for the Beken BK7258 T5-AI board family.
#

config ARCH_BOARD_BK7258
	bool "Beken BK7258 platform"
	depends on ARCH_BOARD_CUSTOM
	default y
	select BOARD_LATE_INITIALIZE
	---help---
		Shared BK7258 CP/AP, boot-chain and peripheral integration. Select
		the physical carrier below so
		board-level GPIOs and capabilities match the assembled hardware.

choice
	prompt "BK7258 physical board"
	default BK7258_BOARD_T5AI_CORE
	depends on ARCH_BOARD_BK7258

config BK7258_BOARD_T5AI_CORE
	bool "T5AI-Core V1.0.1"
	help
		Compact T5-E1 core board with battery management, dual USB-UART,
		P9 user LED, P29 user key, microphone and speaker amplifier.  This
		is the existing board-verified target and remains the default.

config BK7258_BOARD_T5_BOARD
	bool "T5-Board V1.0.2"
	help
		Full T5-E1-IPEX development board with TF card, RGB LCD and DVP
		camera connectors, P1 user LED and P12 ADC key.  Selecting this
		changes board wiring only; chip, CP/AP and boot code remain shared.

config BK7258_BOARD_AIDK_AI_TOY
	bool "AIDK AI Toy (schematic-only bring-up)"
	help
		Minimal AIDK AI Toy board binding. UART0 is the 115200 8N1
		console/download path. SWD, boot hold, RTT, RTS/DTR reset and UART
		flow control remain disabled. Unknown BOM/peripheral routes are not
		claimed; this selector is not a hardware-verified board target.

endchoice

if BK7258_BOARD_T5_BOARD

config BK7258_T5_BOARD_TF_SLOT
	bool "T5-Board TF-card slot"
	default n
	depends on BK7258_AP_CORE && BK7258_PM_CLOCK
	select BK7258_SDIO
	select MMCSD
	select MMCSD_SDIO
	help
		Bind the chip SDIO host to the T5-Board V1.0.2 TF socket.  Board
		wiring is CLK/CMD/D0/D1/D2/D3 = P2/P3/P4/P5/P10/P11.  Real-board
		validation found no usable P6 insertion edge, so profiles must disable
		MMCSD_HAVE_CARDDETECT and insert media before reset.  Hotplug is not
		supported.

config BK7258_T5_BOARD_SDIO_D2_D3_ISOLATED
	bool "S1 isolates UART0 from TF D2/D3"
	default n
	depends on BK7258_T5_BOARD_TF_SLOT
	help
		Assert the physical prerequisite for four-bit TF-card operation:
		S1-1 and S1-2 are OFF, disconnecting the CH342F download UART from
		P10/P11 (TF D2/D3).  Optional serial flash U3 must remain NC/DNP.

config BK7258_SDIO_4BIT
	bool "Use four-bit TF bus"
	default n
	depends on BK7258_T5_BOARD_TF_SLOT
	depends on BK7258_T5_BOARD_SDIO_D2_D3_ISOLATED
	help
		Enable D1/D2/D3 in addition to CLK/CMD/D0.  The safe T5-Board
		default is one bit because D2/D3 share the CH342F UART0 switch route.
		P0/P1 SWD and RTT are independent of this choice.  This selection is
		bound to the separately identified v3.1.1.9-sdio4 AP SDK bundle; the
		default one-line bundle is rejected because its data helpers force the
		controller back to one bit on every transfer.

config BK7258_T5_BOARD_TF_VALIDATION
	bool "Validate T5-Board TF fixed-media read/write"
	default n
	depends on BK7258_T5_BOARD_TF_SLOT && FS_FAT
	help
		Run a bounded, non-destructive test through /dev/mmcsd0 and FAT.  It
		creates, fsyncs, reopens, verifies and removes one 4 KiB file, unmounts,
		then repeats once without removing the card.  It never formats media.
		Insert the card before reset and use only in a validation profile.

config BK7258_T5_BOARD_SARADC_KEY_VALIDATION
	bool "Validate T5-Board ADC key on P12/ADC14"
	default n
	depends on BK7258_AP_CORE && BK7258_SARADC
	depends on BK7258_SARADC_CHAN = 14
	depends on BK7258_SARADC_BUS = 0
	select BK7258_SARADC_VALIDATION
	help
		Bind the chip-generic /dev/adcN validator to the T5-Board V1.0.2
		SW5 ADC key.  The board contributes only the physical P12/ADC14,
		active-low direction and relative transition thresholds; sampling and
		lifecycle logic remain in the reusable chip implementation.

		This is an interactive validation option.  Leave SW5 released for the
		initial phase, press it when prompted, then release it when prompted.
		A static unpressed reading is not a physical key PASS.

endif # BK7258_BOARD_T5_BOARD
```

## board/bk7258_t5ai/Kconfig
```kconfig
#
# NuttX board configuration for the Beken BK7258 (T5-AI) Stage N1 target.
#

config ARCH_BOARD_BK7258_T5AI
	bool "Beken BK7258 T5-AI (Stage N1 minimal)"
	depends on ARCH_BOARD_CUSTOM
	default y
	---help---
		Custom board wrapper for the contest BK7258 BSP.  Stage N1
		produces a minimal NuttX image whose __start prints
		"NUTTX N1\r\n" on UART1 and halts, proving the build chain
		(linker, vector table, BK7236 app magic, postbuild CRC
		expand) emits an image the on-board Tier-1 bootloader can
		validate and jump to.
```

## boards/bk7258/aidk_ai_toy/Kconfig
```kconfig
# Shared BK7258 options; this board's defconfigs select AIDK AI Toy.
source "../vendor/beken/boards/bk7258/common/Kconfig"

config BK7258_BOARD_AIDK_AI_TOY
	bool
	default y
	select BK7258_BOARD_DEFERRED_INIT if BK7258_AP_CORE
	select BK7258_BOARD_HAS_SDIO_BINDING
	select BK7258_BOARD_HAS_USER_GPIO_BINDING
	help
		AIDK AI Toy (BK7258 AI Demo) board: UART0 console, CH340E UART0,
		SC7A20H accelerometer on SoC I2C0 (P20/P21), GC2145 SCCB on SoC
		I2C1 map mode 1 (P42/P43), 1GB SD NAND, MIC1 plus MIC2
		AEC-reference/PA audio, keys/LEDs, MFRC522 NFC and Type-C USB.  CN5's
		single-screen module and CN10's motor are not connected on the current
		board and are not initialized.  Hardware verification is still pending.

config BK7258_AIDK_SD_NAND
	bool "AIDK 1GB SD NAND"
	default n
	depends on BK7258_AP_CORE && BK7258_PM_CLOCK
	select BK7258_BOARD_HAS_SDIO_4BIT
	select BK7258_BOARD_DEFAULT_SDIO_4BIT
	select BK7258_SDIO
	select MMCSD
	select MMCSD_SDIO
	help
		Bind the chip SDIO host to the AIDK soldered 1GB SD NAND on
		SDIO map mode 1 (P14-P19).  No card detect is available; the
		media is always present.

config BK7258_AIDK_DEFERRED_PRIORITY
	int "AIDK attached-device worker priority"
	default 80
	range 1 199
	depends on BK7258_BOARD_DEFERRED_INIT
	help
		SCHED_FIFO priority for post-READY SD NAND and optional attached-device
		bring-up.  It remains below the AP supervisor, RPTUN and radio workers.

config BK7258_AIDK_DEFERRED_STACKSIZE
	int "AIDK attached-device worker stack size"
	default 6144
	range 4096 16384
	depends on BK7258_BOARD_DEFERRED_INIT

config BK7258_AIDK_SC7A20_PHASE0
	bool "Probe AIDK SC7A20H identity at boot"
	default n
	depends on BK7258_BOARD_AIDK_AI_TOY
	depends on BK7258_AP_CORE
	depends on BK7258_I2C && BK7258_I2C_BUS = 0
	help
		Perform a bounded, read-only SC7A20H identity check during AP board
		bring-up.  The board opens the maintained I2C0 character device, reads
		only WHO_AM_I at register 0x0f and requires value 0x11.  It does not
		configure output data rate, axes, FIFO or interrupts and therefore is
		not a production accelerometer driver.

config BK7258_AIDK_SC7A20
	bool "AIDK SC7A20H accelerometer"
	default n
	depends on BK7258_BOARD_AIDK_AI_TOY
	depends on BK7258_AP_CORE
	depends on BK7258_I2C && BK7258_I2C_BUS = 0
	depends on !BK7258_AIDK_SC7A20_PHASE0
	select SENSORS
	select SENSORS_SC7A20
	help
		Bind the fitted SC7A20H accelerometer on I2C0 to the standard NuttX
		sensor upper half as /dev/uorb/sensor_accel0.  Samples use struct
		sensor_accel and SI units.  This is the production sensor binding and
		must not be enabled with the identity-only Phase 0 probe.

config BK7258_AIDK_MFRC522
	bool "AIDK MFRC522 NFC reader as /dev/nfc0"
	default n
	depends on BK7258_BOARD_AIDK_AI_TOY
	depends on BK7258_AP_CORE
	depends on BK7258_UART1
	select DRIVERS_CONTACTLESS
	select CL_MFRC522
	help
		Bind the MFRC522 RFID/NFC reader on the UART1 host interface (P0/P1)
		as /dev/nfc0.  The board supplies only a UART register-transport adapter;
		the standard NuttX MFRC522 driver owns ISO14443-A anticollision, cascade
		selection, CRC and the MFRC522IOC_* interface.

config BK7258_AIDK_BATTERY
	bool "AIDK battery/charge status as /dev/battery"
	default n
	depends on BK7258_BOARD_AIDK_AI_TOY
	depends on BK7258_AP_CORE
	select BATTERY_CHARGER
	select BK7258_SARADC
	help
		Expose the ETA4322 charger and VBAT cell through the standard NuttX
		battery charger upper half at /dev/bat0.  BATIOC_STATE uses P51 5V_DET
		and active-low P26 FULL_DET; BATIOC_GET_VOLTAGE triggers the ADC0 VBAT
		conversion.  The paired CP image must select BK7258_SARADC_SERVER.

config BK7258_AIDK_DUAL_LCD
	bool "AIDK dual GC9D01 SPI framebuffers"
	default n
	depends on BK7258_BOARD_AIDK_AI_TOY
	depends on BK7258_AP_CORE && BK7258_PSRAM
	select BK7258_LCD_SPI
	select LCD
	select LCD_GC9D01
	select LCD_FRAMEBUFFER
	select LCD_EXTERNINIT
	select DRIVERS_VIDEO
	select VIDEO_FB
	help
		Bind both fitted 160x160 GC9D01 panels to the standard NuttX
		framebuffer ABI.  LCD1 is /dev/fb0 on QSPI1 and LCD2 is /dev/fb1 on
		QSPI0.  The board owns the distinct RESET/DC pins and arbitrates the
		P25 backlight and P52 LDO vote shared by both panels.  The generic
		NuttX GC9D01 driver owns panel commands and state; the BK7258 chip
		transport owns only the SPI-over-QSPI DMA data path.

config BK7258_AIDK_CAMERA
	bool "AIDK GC2145 DVP camera as /dev/video0"
	default n
	depends on BK7258_BOARD_AIDK_AI_TOY
	depends on BK7258_AP_CORE && BK7258_DVP && BK7258_PSRAM
	select BK7258_DVP_BOARD_GLUE
	select BK7258_PSRAM_MEDIA
	help
		Bind the fitted AIDK GC2145 and its board-specific power/reset/pinmux
		sequence to the reusable BK7258 DVP imgdata lower half and the standard
		NuttX V4L2 capture upper half.  The initial production profile exposes
		640x480, 30 fps MJPEG through /dev/video0.
```
