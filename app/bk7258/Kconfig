## app/demos/Kconfig
```kconfig
menu "Contest 2026 demos"

source "$APPSDIR/packages/demos/contest2026_135_hello_app/Kconfig"
source "$APPSDIR/packages/demos/contest2026_135_ota_agent/Kconfig"
source "$APPSDIR/packages/demos/contest2026_135_vela_claw/Kconfig"

endmenu # Contest 2026 demos
```

## app/dolphin/Kconfig
```kconfig
# SPDX-License-Identifier: Apache-2.0

config DOLPHIN
	bool "Dolphin command directory"
	default n
	depends on NSH_BUILTIN_APPS && SCHED_WAITPID
	help
		Build the dolphin command directory.  It launches only a fixed set
		of already-built BK7258 command applications; it adds no driver,
		network, or RPC implementation.

if DOLPHIN

config DOLPHIN_STACKSIZE
	int "Dolphin stack size"
	default 4096

endif

config DOLPHIN_FILE_COPY
	bool "Dolphin SD to USB file copy backend"
	default n
	depends on DOLPHIN_UI
	help
		Build the controlled single-file copy backend. It performs no mount,
		format, USB class, or user-interface operation.

config DOLPHIN_STORAGE_ROOT
	string "Dolphin removable storage root"
	default "/mnt/tf"
	depends on DOLPHIN_UI || DOLPHIN_FILE_COPY

if DOLPHIN_FILE_COPY

config DOLPHIN_USB_ROOT
	string "Dolphin USB storage root"
	default "/mnt/usb"

endif

config DOLPHIN_UI
	bool "Dolphin touchscreen desktop"
	default n
	depends on BK7258_AP_CORE && GRAPHICS_LVGL && LV_USE_NUTTX
	depends on LV_USE_NUTTX_TOUCHSCREEN && VIDEO_FB && INPUT_TOUCHSCREEN && NET
	depends on !BK7258_BOARD_HAS_LVGL_UI_BINDING && !BK7258_DISPLAY_SERVICE
	select BK7258_AP_APPLICATION_LIFECYCLE
	help
		Run the local Dolphin desktop on the AP-owned NuttX framebuffer
		and touchscreen. Reuse standard VFS and network status APIs; no
		SDK dependency, cloud provisioning or NFC hardware is assumed.

if DOLPHIN_UI

config DOLPHIN_UI_STACKSIZE
	int "Dolphin UI stack size"
	default 16384
	range 8192 65536

config DOLPHIN_RECORDER
	bool "Dolphin WAV recorder"
	default n
	depends on DOLPHIN_UI && BK7258_MIC && !MEDIA
	help
		Record a user-started 16 kHz, 16-bit mono WAV file to removable
		storage through the existing NuttX audio upper-half adapter.
		This standalone recorder does not start Agent or the Media service.

config DOLPHIN_ADC_KEY
	bool "Dolphin ADC single key"
	default n
	depends on DOLPHIN_UI && ADC

if DOLPHIN_ADC_KEY
config DOLPHIN_ADC_KEY_DEVPATH
	string "ADC device path"
	default "/dev/adc0"
config DOLPHIN_ADC_KEY_CHANNEL
	int "ADC channel"
	default 14
config DOLPHIN_ADC_KEY_RELEASE_MIN
	int "Calibrated released raw minimum"
	default 0
	# Zero deliberately disables input until the board owner supplies a raw gate.
config DOLPHIN_ADC_KEY_ACTIVE_LOW
	bool "Pressed level is lower than released level"
	default y
endif

endif
```

## app/hello_app/Kconfig
```kconfig
#
# For a description of the syntax of this configuration file,
# see the file kconfig-language.txt in the NuttX tools repository.
#

# Each user-visible NSH command has its own application Kconfig.  The
# underlying driver/feature symbols must never register an application;
# CMake and Classic Make register commands only from CONFIG_BK7258_APP_*.

config BK7258_APP_HELLO
	bool "Contest 2026 team 135 hello app"
	default n
	depends on SYSTEM_NSH
	select BUILTIN
	select NSH_BUILTIN_APPS
	---help---
		Enable the contest 2026 team 135 hello app demo.

if BK7258_APP_HELLO

config BK7258_APP_HELLO_PROGNAME
	string "hello app program name"
	default "hello_app"

config BK7258_APP_HELLO_PRIORITY
	int "hello app priority"
	default 100

config BK7258_APP_HELLO_STACKSIZE
	int "hello app stack size"
	default 2048

endif

config BK7258_APP_BKVALIDATE
	bool "BK7258 public-API validation dispatcher"
	default n
	depends on SYSTEM_NSH
	select BUILTIN
	select NSH_BUILTIN_APPS
	---help---
		Build the metadata-driven bkvalidate list/run/all-compatible dispatcher.
		The dispatcher uses public device APIs or versioned diagnostic records and
		never calls vendor SDK entry points.  Generic JPEG and temperature
		validation start only through their explicit run commands.

if BK7258_APP_BKVALIDATE

config BK7258_APP_BKVALIDATE_PROGNAME
	string "bkvalidate program name"
	default "bkvalidate"

config BK7258_APP_BKVALIDATE_PRIORITY
	int "bkvalidate priority"
	default 100

config BK7258_APP_BKVALIDATE_STACKSIZE
	int "bkvalidate stack size"
	default 3072

endif

config BK7258_APP_APCTL
	bool "BK7258 AP start/stop/restart command (apctl)"
	default n
	depends on BK7258_AP_CONTROL
	select BUILTIN
	select NSH_BUILTIN_APPS
	---help---
		Enable the manual apctl NSH command for the CPU0 AP control
		wrapper.  The wrapper itself is a driver feature owned by
		BK7258_AP_CONTROL and may run with the command disabled.

if BK7258_APP_APCTL

config BK7258_APP_APCTL_PROGNAME
	string "apctl program name"
	default "apctl"

config BK7258_APP_APCTL_PRIORITY
	int "apctl priority"
	default 100

config BK7258_APP_APCTL_STACKSIZE
	int "apctl stack size"
	default 2048

endif

config BK7258_APP_RPMSG_TEST
	bool "BK7258 RPMsg bounded concurrency test command"
	default n
	depends on BK7258_RPMSG_TEST && !BK7258_AP_CORE && SYSTEM_NSH
	select BUILTIN
	select NSH_BUILTIN_APPS
	---help---
		Enable the CP-side bkrpmsgtest NSH command.  The RPMsg test
		endpoint is owned by BK7258_RPMSG_TEST and is enabled
		independently of this command.

if BK7258_APP_RPMSG_TEST

config BK7258_APP_RPMSG_TEST_PROGNAME
	string "bkrpmsgtest program name"
	default "bkrpmsgtest"

config BK7258_APP_RPMSG_TEST_PRIORITY
	int "bkrpmsgtest priority"
	default 100

config BK7258_APP_RPMSG_TEST_STACKSIZE
	int "bkrpmsgtest stack size"
	default 3072

endif

config BK7258_APP_RPMSGFS_TEST
	bool "BK7258 RPMsgFS functional and recovery test command"
	default n
	depends on BK7258_RPMSGFS_TEST && !BK7258_AP_CORE && SYSTEM_NSH
	select BUILTIN
	select NSH_BUILTIN_APPS
	---help---
		Enable the CP-side bkrpmsgfstest NSH command.  The RPMsgFS test
		endpoint is owned by BK7258_RPMSGFS_TEST and is enabled
		independently of this command.

if BK7258_APP_RPMSGFS_TEST

config BK7258_APP_RPMSGFS_TEST_PROGNAME
	string "bkrpmsgfstest program name"
	default "bkrpmsgfstest"

config BK7258_APP_RPMSGFS_TEST_PRIORITY
	int "bkrpmsgfstest priority"
	default 100

config BK7258_APP_RPMSGFS_TEST_STACKSIZE
	int "bkrpmsgfstest stack size"
	default 3072

endif

config BK7258_APP_BT_IPC_TEST
	bool "BK7258 Bluetooth IPC hardware test command"
	default n
	depends on BK7258_BT_IPC_TEST && !BK7258_AP_CORE && SYSTEM_NSH
	select BUILTIN
	select NSH_BUILTIN_APPS
	---help---
		Enable the CP-side bkbttest NSH command.  The Bluetooth IPC test
		endpoint is owned by BK7258_BT_IPC_TEST and is enabled
		independently of this command.

if BK7258_APP_BT_IPC_TEST

config BK7258_APP_BT_IPC_TEST_PROGNAME
	string "bkbttest program name"
	default "bkbttest"

config BK7258_APP_BT_IPC_TEST_PRIORITY
	int "bkbttest priority"
	default 100

config BK7258_APP_BT_IPC_TEST_STACKSIZE
	int "bkbttest stack size"
	default 3072

endif

config BK7258_APP_WIFI
	bool "BK7258 Wi-Fi STA command (bkwifi)"
	default n
	depends on BK7258_WIFI_VNET && !BK7258_AP_CORE && SYSTEM_NSH
	select BUILTIN
	select NSH_BUILTIN_APPS
	---help---
		Enable the CP-side bkwifi NSH command.  The Wi-Fi VNET driver is
		owned by BK7258_WIFI_VNET and is enabled independently of this
		command.

if BK7258_APP_WIFI

config BK7258_APP_WIFI_PROGNAME
	string "bkwifi program name"
	default "bkwifi"

config BK7258_APP_WIFI_PRIORITY
	int "bkwifi priority"
	default 100

config BK7258_APP_WIFI_STACKSIZE
	int "bkwifi stack size"
	default 4096

endif

config BK7258_APP_PSRAM_TEST
	bool "BK7258 bounded PSRAM allocator test command"
	default n
	depends on BK7258_PSRAM_TEST && !BK7258_AP_CORE && SYSTEM_NSH
	select BUILTIN
	select NSH_BUILTIN_APPS
	---help---
		Enable the CP-side bkpsramtest NSH command.  The PSRAM allocator
		gate is owned by BK7258_PSRAM_TEST and runs independently of this
		command.

if BK7258_APP_PSRAM_TEST

config BK7258_APP_PSRAM_TEST_PROGNAME
	string "bkpsramtest program name"
	default "bkpsramtest"

config BK7258_APP_PSRAM_TEST_PRIORITY
	int "bkpsramtest priority"
	default 100

config BK7258_APP_PSRAM_TEST_STACKSIZE
	int "bkpsramtest stack size"
	default 3072

endif

config BK7258_APP_GPIO_TEST
	bool "BK7258 selected-board GPIO foundation test command"
	default n
	depends on ARCH_CHIP_BK7258 && SYSTEM_NSH && !BK7258_AP_CORE
	depends on BK7258_BOARD_HAS_USER_GPIO_BINDING
	select BK7258_GPIO_FOUNDATION_TEST
	select BUILTIN
	select NSH_BUILTIN_APPS
	---help---
		Enable the manual bkgpioc0 NSH command.  The board GPIO binding is
		owned by the selected board and is enabled independently of this
		command.

if BK7258_APP_GPIO_TEST

config BK7258_APP_GPIO_TEST_PROGNAME
	string "bkgpioc0 program name"
	default "bkgpioc0"

config BK7258_APP_GPIO_TEST_PRIORITY
	int "bkgpioc0 priority"
	default 100

config BK7258_APP_GPIO_TEST_STACKSIZE
	int "bkgpioc0 stack size"
	default 2048

endif

config BK7258_APP_GPIO_IRQ_TEST
	bool "BK7258 selected-board key GPIO edge IRQ test command"
	default n
	depends on BK7258_SDK_IRQ_BRIDGE && SYSTEM_NSH
	depends on BK7258_BOARD_HAS_USER_GPIO_BINDING
	select BK7258_GPIO_IRQ_TEST
	select BUILTIN
	select NSH_BUILTIN_APPS
	---help---
		Enable the manual bkgpioirq NSH command.  The SDK IRQ bridge and
		board GPIO binding are driver features enabled independently of
		this command.

if BK7258_APP_GPIO_IRQ_TEST

config BK7258_APP_GPIO_IRQ_TEST_PROGNAME
	string "bkgpioirq program name"
	default "bkgpioirq"

config BK7258_APP_GPIO_IRQ_TEST_PRIORITY
	int "bkgpioirq priority"
	default 100

config BK7258_APP_GPIO_IRQ_TEST_STACKSIZE
	int "bkgpioirq stack size"
	default 2048

endif

config BK7258_APP_IRQ_TIMER_TEST
	bool "Beken SDK IRQ bridge TIMER1 manual test command"
	default n
	depends on BK7258_SDK_IRQ_BRIDGE && SYSTEM_NSH
	select BK7258_SDK_IRQ_TIMER_TEST
	select BUILTIN
	select NSH_BUILTIN_APPS
	---help---
		Enable the manual bkirqtest NSH command.  The SDK IRQ bridge is a
		driver feature enabled independently of this command.

if BK7258_APP_IRQ_TIMER_TEST

config BK7258_APP_IRQ_TIMER_TEST_PROGNAME
	string "bkirqtest program name"
	default "bkirqtest"

config BK7258_APP_IRQ_TIMER_TEST_PRIORITY
	int "bkirqtest priority"
	default 100

config BK7258_APP_IRQ_TIMER_TEST_STACKSIZE
	int "bkirqtest stack size"
	default 2048

endif

config BK7258_APP_TIMER_SELFTEST
	bool "Beken SDK software-timer lifecycle regression test command"
	default n
	depends on ARCH_CHIP_BK7258 && !BK7258_AP_CORE && SYSTEM_NSH
	select BK7258_SDK_TIMER_SELFTEST
	select BUILTIN
	select NSH_BUILTIN_APPS
	---help---
		Enable the manual bktimertest NSH command.  The SDK software-timer
		service is a driver feature enabled independently of this command.

if BK7258_APP_TIMER_SELFTEST

config BK7258_APP_TIMER_SELFTEST_PROGNAME
	string "bktimertest program name"
	default "bktimertest"

config BK7258_APP_TIMER_SELFTEST_PRIORITY
	int "bktimertest priority"
	default 100

config BK7258_APP_TIMER_SELFTEST_STACKSIZE
	int "bktimertest stack size"
	default 2048

endif
```

## app/ota_agent/Kconfig
```kconfig
config BK7258_APP_OTA_AGENT
	bool "BK7258 unified OTA manager command"
	default n
	depends on BK7258_OTA_MANAGER && SYSTEM_NSH
	select BUILTIN
	select NSH_BUILTIN_APPS
	---help---
		Expose the AP product OTA manager as `ota status|apply-file|cancel`.
		apply-file accepts only an extracted directory containing a catalog
		signed by the build-pinned MCUboot root.

if BK7258_APP_OTA_AGENT

config BK7258_APP_OTA_AGENT_PROGNAME
	string "OTA manager program name"
	default "ota"

config BK7258_APP_OTA_AGENT_PRIORITY
	int "OTA manager command priority"
	default 100

config BK7258_APP_OTA_AGENT_STACKSIZE
	int "OTA manager command stack size"
	default 8192

config BK7258_APP_OTA_AGENT_TIMEOUT_MS
	int "Complete pair staging timeout (milliseconds)"
	default 900000
	range 60000 3600000

endif
```

## app/testing/bk7258/Kconfig
```kconfig
# SPDX-License-Identifier: Apache-2.0

config TESTS_BK7258_RPMSG_EXEC
	bool "BK7258 AP driver-check commands over RPMsg"
	default n
	depends on ARCH_CHIP_BK7258 && BK7258_AP_CORE && BK7258_RPTUN
	select BK7258_AP_APPLICATION_LIFECYCLE
	select NET
	select NET_RPMSG
	select NET_LOCAL
	select NET_LOCAL_STREAM
	select NETUTILS_REXECD
	select NSH_LIBRARY
	select NSH_CONSOLE
	select SYSTEM_READLINE
	select NSH_BUILTIN_APPS
	select BUILTIN
	select SYSTEM_POPEN
	select PIPES
	select LIBC_EXECFUNCS
	help
		Start the official rexecd application with AF_RPMSG after normal AP
		startup.  CP can run selected standard driver tests without an AP
		UART console.  This belongs only in explicit drivercheck profiles;
		it does not start an IPv4/IPv6 listener or run tests automatically.

config TESTS_BK7258_NATIVE_APPS
	bool "BK7258 AP native ELF loader smoke test"
	default n
	depends on ARCH_CHIP_BK7258 && BK7258_AP_CORE && BK7258_NATIVE_APPS
	select LIBC_ELF
	help
		Build one firmware-owned ARM ET_REL fixture and, when explicitly
		started by the AP lifecycle, load and release it 100 times on the AP
		transport-owner CPU. On SMP builds, also execute an already loaded,
		import-free callback on CPU1 and verify that CPU1 cannot enter the ELF
		or native-manager lifecycle. This is a bounded hardware-component
		check, not an application marketplace or package-install test.

config TESTS_BK7258_NATIVE_TRACE
	bool "BK7258 native-test RPMsg lock diagnostics"
	default n
	depends on TESTS_BK7258_NATIVE_APPS
	help
		Instrument OpenAMP and the RPMsg notification path, keeping a bounded
		per-core call ring for CP readback. Raise SysTick priority to sample
		masked lock waits without entering the kernel. This changes timing
		and can drop ticks; use only for diagnosis, never acceptance results.
		It does not modify upstream source files.

config TESTS_BK7258_NATIVE_TRANSPORT
	bool "BK7258 native-test CPU1 transport isolation"
	default n
	depends on TESTS_BK7258_NATIVE_APPS && BK7258_RPTUN && SMP
	help
		Run a bounded diagnostic that compares CPU0 and CPU1 local-file work,
		then calls the existing RPTUN proof endpoint directly from each AP
		logical CPU.  This deliberately bypasses the product CPU0 transport
		ownership rule and may fault the diagnostic image.  Never enable it in
		a product or acceptance configuration.

config TESTS_BK7258_CMOCKA
	tristate "BK7258 CP/AP lifecycle contract tests"
	default n
	depends on TESTING_CMOCKA
	depends on ARCH_SETJMP_H
	depends on ARCH_CHIP_BK7258
	depends on ARCH_BOARD_BK7258
	depends on !BK7258_AP_CORE
	depends on BK7258_AP_CONTROL
	help
		Build the target-side CMocka contract shared by every maintained
		BK7258 physical board.  It publishes the configured board identity
		and verifies the public UART0 device contract and the versioned AP
		lifecycle and supervisor interfaces without calling vendor SDK APIs.

if TESTS_BK7258_CMOCKA

config TESTS_BK7258_CMOCKA_PRIORITY
	int "BK7258 CMocka task priority"
	default 100

config TESTS_BK7258_CMOCKA_STACKSIZE
	int "BK7258 CMocka task stack size"
	default 4096

endif

config TESTS_BK7258_SMP_DIAG
	tristate "BK7258 AP SMP exclusive-access diagnostic command"
	default n
	depends on BK7258_AP_SMP_DIAG
	help
		Build "bksmpdiag", a diagnostic-only command that runs the chip
		AP SMP stress and prints machine-readable BKSMPDIAG records.
		Never enable in a product or acceptance configuration.

if TESTS_BK7258_SMP_DIAG

config TESTS_BK7258_SMP_DIAG_PRIORITY
	int "bksmpdiag task priority"
	default 100

config TESTS_BK7258_SMP_DIAG_STACKSIZE
	int "bksmpdiag task stack size"
	default 4096

endif
```
